ENTRY(_start)

SECTIONS
{
    . = 0x40300000; /* Load user program after kernel & heap */

    .text :
    {
        *(.text*)
    }

    .rodata :
    {
        *(.rodata*)
    }

    .data :
    {
        *(.data*)
    }

    .bss :
    {
        *(.bss*)
    }
}
